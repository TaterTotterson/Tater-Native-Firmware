## main/Kconfig.projbuild
```kconfig
menu "Tater Native Satellite"

config TATER_USB_ETHERNET
    bool "RTL8152 USB Ethernet host"
    default n
    depends on IDF_TARGET_ESP32S3
    help
        USB Ethernet for a powered 0bda:8152 ECM adapter on the ESP USB port.
        Shares the internal PHY with USB Serial/JTAG. A PC detected at startup
        retains the console for that boot. No eFuses or USB power GPIOs change.

config TATER_WIFI_SSID
    string "Wi-Fi SSID"
    default ""

config TATER_WIFI_PASSWORD
    string "Wi-Fi password"
    default ""

config TATER_SERVER_URL
    string "Tater server URL"
    default "ws://tater.local:8501"
    help
        Base Tater server URL. The firmware appends /api/tater/satellite/v1/ws
        unless the full native satellite WebSocket path is already present.

config TATER_SATELLITE_TOKEN
    string "Satellite token"
    default ""
    help
        Used as X-Tater-Token when Tater API auth is enabled.

config TATER_DEVICE_ID_PREFIX
    string "Legacy device ID prefix"
    default "voicepe"
    help
        Retained for older sdkconfig files. Native multi-board builds derive
        identity from the selected board so one board cannot masquerade as
        another because of a stale build configuration.

config TATER_DEVICE_NAME
    string "Legacy device name"
    default "Tater Voice PE"
    help
        Retained for older sdkconfig files. Each board supplies its own default
        name; names chosen during provisioning still take precedence.

config TATER_ROOM
    string "Room"
    default ""

config TATER_LOG_VERBOSE_AUDIO
    bool "Verbose audio logging"
    default n

config TATER_PLAYBACK_MAX_BYTES
    int "Maximum downloaded playback WAV bytes"
    default 3145728

endmenu
```
